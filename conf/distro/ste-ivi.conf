## conf/distro/ste-ivi.conf
```bitbake
include conf/distro/b2qt.conf

DISTRO = "ste-ivi"
DISTRO_NAME = "Solar Team Eindhoven In-Vehicle Infotainment distribution"
DISTRO_VERSION = "0.1.0"
SDK_VERSION := "${DISTRO_VERSION}"

SDK_MACHINE = "${@d.getVar('SDKMACHINE', True) or '${SDK_ARCH}'}"
SDK_NAME = "${DISTRO}-${SDK_MACHINE}-${IMAGE_BASENAME}"
TOOLCHAIN_OUTPUTNAME = "${SDK_NAME}-${MACHINE}"
BUILDCFG_VARS += "SDKMACHINE"

MAINTAINER = "Steven van der Schoot <steven.vanderschoot@solarteameindhoven.nl>"

QT_DIR_NAME = ""

# TODO: Move this to somewhere in meta-raspberrypi-extra
KERNEL_DEVICETREE = " \
	bcm2710-rpi-3-b.dtb \
	overlays/vc4-kms-v3d.dtbo \
	overlays/ad7998.dtbo \
"

SANITY_TESTED_DISTROS += " \
            Fedora 23 \n \
            "
```
